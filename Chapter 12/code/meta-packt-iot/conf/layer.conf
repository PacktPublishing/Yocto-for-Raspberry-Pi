## Chapter 12/code/meta-packt-iot/conf/layer.conf
```bitbake
# We have a conf and classes directory, add to BBPATH
BBPATH .= ":${LAYERDIR}"

# We have recipes-* directories, add to BBFILES
BBFILES += "${LAYERDIR}/recipes-*/*/*.bb \
	${LAYERDIR}/recipes-*/*/*.bbappend"

BBFILE_COLLECTIONS += "packt-iot"
BBFILE_PATTERN_packt-iot = "^${LAYERDIR}/"
BBFILE_PRIORITY_packt-iot = "10"
```

## Code Files/meta-packt_rpi/conf/layer.conf
```bitbake
# We have a conf and classes directory, add to BBPATH
BBPATH .= ":${LAYERDIR}"

# We have recipes-* directories, add to BBFILES
BBFILES += "${LAYERDIR}/recipes-*/*/*.bb \
	${LAYERDIR}/recipes-*/*/*.bbappend"

BBFILE_COLLECTIONS += "packt_rpi"
BBFILE_PATTERN_packt_rpi = "^${LAYERDIR}/"
BBFILE_PRIORITY_packt_rpi = "6"
```
